## examples/01-blinky/Kconfig.projbuild
```kconfig
choice BOARD_SELECT
    prompt "Target board"
    default BOARD_ADAFRUIT_HUZZAH32

    config BOARD_ADAFRUIT_HUZZAH32
        bool "Adafruit HUZZAH32 (ESP32 Feather)"

    config BOARD_SEEED_XIAO_ESP32S3
        bool "Seeed XIAO ESP32S3"
endchoice
```

## examples/esp-now-low-power-mesh/main/Kconfig.projbuild
```kconfig
menu "ESP-NOW Mesh Configuration"

choice NODE_ROLE
    prompt "Node role"
    default NODE_ROLE_SENSOR
    help
        Select the role compiled into this firmware image.
        Build once per role; all boards of the same role receive the same binary.

config NODE_ROLE_SENSOR
    bool "Sensor"
    help
        Wake from deep sleep, scan WiFi RSSI for configured SSIDs, transmit to gateway.

config NODE_ROLE_RELAY
    bool "Relay"
    help
        Always-on forwarder. Receives from sensors, forwards to gateway with deduplication.

config NODE_ROLE_GATEWAY
    bool "Gateway"
    help
        Always-on receiver. Broadcasts beacon for dynamic discovery, logs all received packets.

config NODE_ROLE_SENSOR_RELAY
    bool "Sensor+Relay (light sleep)"
    help
        Combines sensor and relay roles using ESP-IDF light sleep. The radio stays alive
        in periodic listen mode so ESP-NOW receive (relay forwarding) works while the CPU
        is halted. A periodic timer wakes the node to run a WiFi RSSI scan and transmit
        its own payload. Average current ~1-5 mA — much lower than an always-on relay,
        higher than a deep-sleeping sensor.

endchoice

config ESPNOW_CHANNEL
    int "ESP-NOW WiFi channel"
    default 1
    range 1 13
    help
        WiFi channel shared by all nodes in the mesh. Every node must use the same value.
        Channel mismatch is the most common silent failure in ESP-NOW deployments.

config SENSOR_SLEEP_SEC
    int "Sensor deep sleep duration (seconds)"
    default 60
    range 10 3600
    help
        How long the sensor sleeps between WiFi scans and transmissions.
        Only used by the sensor role; ignored by relay and gateway.

config SENSOR_RELAY_SCAN_INTERVAL_SEC
    int "Sensor-relay scan interval (seconds)"
    default 60
    range 10 3600
    help
        How often the sensor-relay node runs a WiFi RSSI scan and sends its own payload.
        Between scans the node is in light sleep, forwarding packets from other sensors.
        Only used by the SENSOR_RELAY role; ignored by all other roles.

config TARGET_SSID_1
    string "Target SSID 1"
    default ""
    help
        First SSID to scan for RSSI. Empty string disables this slot (reports -128 dBm).
        Only used by the sensor role; ignored by relay and gateway.

config TARGET_SSID_2
    string "Target SSID 2"
    default ""
    help
        Second SSID to scan for RSSI. Empty string disables this slot.
        Only used by the sensor role; ignored by relay and gateway.

config TARGET_SSID_3
    string "Target SSID 3"
    default ""
    help
        Third SSID to scan for RSSI. Empty string disables this slot.
        Only used by the sensor role; ignored by relay and gateway.

config MESH_BLINK_GPIO
    int "LED GPIO number"
    default 21
    range 0 48
    help
        GPIO connected to the user LED. Default 21 is the XIAO ESP32S3 orange LED.
        Update for other boards (e.g. 13 for HUZZAH32, 15 for XIAO ESP32-C6).

config MESH_LED_WS2812
    bool "LED is a WS2812B addressable RGB (requires RMT driver)"
    default n
    help
        Set for boards whose LED is a WS2812B NeoPixel (e.g. ESP32-C6-DevKitC-1-N8 GPIO 8,
        YEJMKJ ESP32-S3-DevKitC-1-N16R8 GPIO 48). gpio_set_level() has no effect on these
        LEDs; the RMT peripheral generates the required 800 kHz NRZ waveform instead.
        When set: green = success/activity, red = failure, off = idle.
        When clear: simple GPIO toggle is used (active-HIGH or active-LOW per MESH_BLINK_ACTIVE_LOW).

config MESH_BLINK_ACTIVE_LOW
    bool "LED is active LOW (ON when GPIO = LOW)"
    default y
    help
        Set for boards where the LED turns on when the GPIO is driven LOW (default).
        Clear for active-HIGH boards such as the Adafruit HUZZAH32 (GPIO 13, active HIGH).
        Not applicable when MESH_LED_WS2812 is set (WS2812 path ignores this symbol).

config MESH_LED_TASK_STACK_SIZE
    int "LED task stack size (bytes)"
    default 2048
    range 1024 8192
    help
        Stack size for the mesh_led_task. 2048 bytes is sufficient for the task
        notification wait, gpio_set_level call, and vTaskDelay.

endmenu
```

## examples/esp-now-low-power-mesh/sdkconfig.defaults
```kconfig
# ESP-NOW Low-Power Mesh — common + sensor role defaults (Seeed XIAO ESP32S3)
CONFIG_NODE_ROLE_SENSOR=y

# Console: XIAO ESP32S3 uses native USB CDC (no UART bridge)
CONFIG_ESP_CONSOLE_USB_CDC=y

# Sensor app_main stack: 6144 bytes for WiFi scan buffers + ESP-NOW init/deinit frames
CONFIG_ESP_MAIN_TASK_STACK_SIZE=6144

# Task watchdog: 10-second timeout, sensor deletes itself before deep sleep
CONFIG_ESP_TASK_WDT_EN=y
CONFIG_ESP_TASK_WDT_TIMEOUT_S=10

# Stack overflow detection via canary
CONFIG_FREERTOS_CHECK_STACKOVERFLOW_CANARY=y

# Log level: INFO for operational events
CONFIG_LOG_DEFAULT_LEVEL_INFO=y
CONFIG_LOG_DEFAULT_LEVEL=3
```

## examples/esp-now-low-power-mesh/sdkconfig.defaults.esp32
```kconfig
# ESP-NOW Low-Power Mesh — ESP32 (original) board overrides
# Applies to: Adafruit HUZZAH32, generic ESP32 DevKit boards
# Layer over sdkconfig.defaults before any role override.

# Override USB CDC from base sdkconfig.defaults (ESP32 has no native USB)
CONFIG_ESP_CONSOLE_USB_CDC=n

# LED: GPIO 13, active HIGH (Adafruit HUZZAH32 red LED)
CONFIG_MESH_BLINK_GPIO=13
CONFIG_MESH_BLINK_ACTIVE_LOW=n
CONFIG_TARGET_SSID_1="NaszGo"                                                                                                               
CONFIG_TARGET_SSID_2="NaszGoEdge"                                                                                                                
CONFIG_TARGET_SSID_3="NETGEAR39" 
```

## examples/esp-now-low-power-mesh/sdkconfig.defaults.esp32c6
```kconfig
# ESP-NOW Low-Power Mesh — ESP32-C6 board overrides
# Applies to: Espressif ESP32-C6-DevKitC-1-N8, Seeed XIAO ESP32-C6
# Layer over sdkconfig.defaults before any role override.

# USB Serial/JTAG replaces USB CDC (ESP32-C6 has no OTG peripheral)
CONFIG_ESP_CONSOLE_USB_CDC=n
CONFIG_ESP_CONSOLE_USB_SERIAL_JTAG=y

# LED: WS2812B on GPIO 8 (ESP32-C6-DevKitC-1-N8) — requires RMT driver
CONFIG_MESH_BLINK_GPIO=8
CONFIG_MESH_LED_WS2812=y
CONFIG_TARGET_SSID_1="NaszGo"                                                                                                               
CONFIG_TARGET_SSID_2="NaszGoEdge"                                                                                                                
CONFIG_TARGET_SSID_3="NETGEAR39" 
```

## examples/esp-now-low-power-mesh/sdkconfig.defaults.gateway
```kconfig
# ESP-NOW Low-Power Mesh — gateway role override
# Layer over sdkconfig.defaults:
#   SDKCONFIG_DEFAULTS="sdkconfig.defaults;sdkconfig.defaults.gateway"
CONFIG_NODE_ROLE_SENSOR=n
CONFIG_NODE_ROLE_GATEWAY=y

# Gateway app_main stack: 4096 bytes — init frames only, no scan buffer needed
CONFIG_ESP_MAIN_TASK_STACK_SIZE=4096
```
