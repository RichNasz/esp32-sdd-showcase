## examples/esp-now-low-power-mesh/sdkconfig.defaults.relay
```kconfig
# ESP-NOW Low-Power Mesh — relay role override
# Layer over sdkconfig.defaults:
#   SDKCONFIG_DEFAULTS="sdkconfig.defaults;sdkconfig.defaults.relay"
CONFIG_NODE_ROLE_SENSOR=n
CONFIG_NODE_ROLE_RELAY=y

# Relay app_main stack: 4096 bytes — init frames only, no scan buffer needed
CONFIG_ESP_MAIN_TASK_STACK_SIZE=4096
```

## examples/esp-now-low-power-mesh/sdkconfig.defaults.sensor-relay
```kconfig
# ESP-NOW Low-Power Mesh — sensor-relay role override
# Layer over sdkconfig.defaults (and optionally a board layer) before building.
# SDKCONFIG_DEFAULTS="sdkconfig.defaults;sdkconfig.defaults.<board>;sdkconfig.defaults.sensor-relay"

CONFIG_NODE_ROLE_SENSOR_RELAY=y
CONFIG_ESP_MAIN_TASK_STACK_SIZE=6144

# Light sleep via ESP-IDF power management.
# CPU halts during FreeRTOS idle; radio stays in DTIM listen mode for ESP-NOW receive.
CONFIG_PM_ENABLE=y
CONFIG_FREERTOS_USE_TICKLESS_IDLE=y
CONFIG_ESP_WIFI_STA_DISCONNECTED_PM_ENABLE=y
```
